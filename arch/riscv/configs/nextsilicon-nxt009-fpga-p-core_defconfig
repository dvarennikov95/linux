## arch/riscv/configs/nextsilicon-nxt009-fpga-p-core_defconfig
```kconfig
CONFIG_DEFAULT_HOSTNAME="nextpcore"
CONFIG_NONPORTABLE=y
CONFIG_ARCH_RV64I=y
CONFIG_64BIT=y
CONFIG_RISCV_ISA_C=n
CONFIG_RISCV_ISA_SVPBMT=n
CONFIG_FPU=y
CONFIG_SMP=n
CONFIG_NR_CPUS=1
CONFIG_EFI=n
CONFIG_RISCV_SBI_V01=y
CONFIG_SERIAL_EARLYCON_RISCV_SBI=y
CONFIG_SERIAL_8250=y
# CONFIG_SERIAL_8250_CONSOLE=y

#todo: add CONFIG_NXT_TTY and move CONFIG_CONSOLE_POLL , CONFIG_NXT_TTY_CONSOLE under it
# CONFIG_CONSOLE_POLL=y
# CONFIG_NXT_TTY_CONSOLE=y
CONFIG_SERIAL_8250_DW=y
CONFIG_SERIAL_OF_PLATFORM=y
CONFIG_BLK_DEV_INITRD=y
CONFIG_RD_GZIP=y
CONFIG_DEBUG_VM=y
#gdb
CONFIG_DEBUG_KERNEL=y
CONFIG_DEBUG_INFO_DWARF_TOOLCHAIN_DEFAULT=y # CONFIG_DEBUG_INFO needed for CONFIG_GDB_SCRIPTS but it can't be set directly
CONFIG_GDB_SCRIPTS=y
# CONFIG_DEBUG_INFO_REDUCED=n
# CONFIG_DEBUG_INFO_NONE=n
# CONFIG_DEBUG_INFO_SPLIT=n

CONFIG_TRACEPOINTS=y
CONFIG_DYNAMIC_DEBUG=y
CONFIG_PRINTK_TIME=y
CONFIG_KALLSYMS=1

CONFIG_BLK_DEV_RAM=y
CONFIG_DEVTMPFS=y
CONFIG_DEVTMPFS_MOUNT=y

GENERIC_MSI_DOMAIN_OPS=y
```
